## dts/bindings/zmk,input-processor-axis-snap.yaml
```yaml
description: Input processor that snaps pointer motion to the dominant axis (X or Y)

compatible: "zmk,input-processor-axis-snap"

include: ip_zero_param.yaml

properties:
  idle-ms:
    type: int
    default: 150
    description: A pause longer than this releases the axis lock.
  decide-threshold:
    type: int
    default: 4
    description: Accumulated movement counts needed before an axis is chosen. Nothing is output until then.
  switch-ratio:
    type: int
    default: 3
    description: The other axis must exceed the locked axis by this factor to switch axes without pausing.
```

## dts/bindings/zmk,input-processor-rotate.yaml
```yaml
description: Input processor that rotates pointer motion by a fixed angle

compatible: "zmk,input-processor-rotate"

include: ip_zero_param.yaml

properties:
  angle:
    type: int
    default: 0
    description: Rotation in degrees. Positive is counter-clockwise as seen on screen.
```

## dts/bindings/zmk,input-processor-temp-layer-ext.yaml
```yaml
description: Temp-layer input processor whose hold timer is also restarted by key presses

compatible: "zmk,input-processor-temp-layer-ext"

include: ip_two_param.yaml

properties:
  require-prior-idle-ms:
    type: int
    required: false
    default: 0
    description: Time in milliseconds that must pass after the last keystroke before the layer can be toggled

  excluded-positions:
    type: array
    required: false
    default: []
    description: Key positions that will NOT deactivate the layer when pressed

  extend-positions:
    type: array
    required: false
    default: []
    description: Key positions that restart the hold timer when pressed while the layer is active
```
